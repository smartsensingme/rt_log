## CMakeLists.txt
```
cmake_minimum_required(VERSION 3.20.0)

list(APPEND ZEPHYR_EXTRA_MODULES "${CMAKE_CURRENT_LIST_DIR}/../..")
find_package(Zephyr REQUIRED HINTS $ENV{ZEPHYR_BASE})
project(rt_log_basic)
target_sources(app PRIVATE src/main.c)
```

## prj.conf
```kconfig
CONFIG_LOG=y
CONFIG_LOG_MODE_DEFERRED=y
CONFIG_RT_LOG=y
CONFIG_RT_LOG_MAX_LEVEL=5
CONFIG_RT_LOG_DEFAULT_LEVEL=3
CONFIG_RT_LOG_FLOAT_SUPPORT=y
CONFIG_MAIN_STACK_SIZE=2048
```

## src/main.c
```c
/* SPDX-License-Identifier: Apache-2.0 */
#include <zephyr/kernel.h>

#include <rt_log/log.h>

RT_LOG_MODULE_REGISTER(log_example);

/** Zephyr entry; called externally at boot. Demonstrates native formatting and
 * runtime tag filtering without any diagnostics/client/board library.
 * Calls rt_log_level_set, RT_LOGI/SCI/D and kernel sleep; no retained pointers.
 */
int main(void)
{
	int rc = rt_log_level_set("EXAMPLE", RT_LOG_INFO);
	if (rc)
		return rc;

	for (;;) {
		RT_LOGI("EXAMPLE", "decimal=%02.04f", 1.56);
		RT_LOG_SCI("EXAMPLE", "current_a", 0.00156);
		RT_LOGD("EXAMPLE", "filtered until runtime level allows DEBUG");
		k_msleep(5000);
	}
}
```
